## conf/layer.conf
```bitbake
# We have a conf and classes directory, add to BBPATH
BBPATH .= ":${LAYERDIR}"

# We have recipes-* directories, add to BBFILES
BBFILES += "${LAYERDIR}/recipes-*/*/*.bb \
            ${LAYERDIR}/recipes-*/*/*.bbappend"

BBFILE_COLLECTIONS += "meta-custom-sysfs"
BBFILE_PATTERN_meta-custom-sysfs = "^${LAYERDIR}/"
BBFILE_PRIORITY_meta-custom-sysfs = "6"

LAYERDEPENDS_meta-custom-sysfs = "core"
LAYERSERIES_COMPAT_meta-custom-sysfs = "scarthgap mickledore"
```
